/*
 * Author: Claude (Anthropic) for Ken Rother's YACC1 project, 2026
 */

/*
 * acrtcmodel.h - the HD63484 ACRTC of the video card V3, as both emulators hold it (2026-11-11).
 *
 * docs/cards/video-v3.md is the card; Hitachi's HD63484 ACRTC User's Manual (1985) is the chip, and the section and
 * figure numbers below are its. videomodel.h includes this file and gives the chip its two addresses (ports PA-PD).
 * The chip is in its 8-bit bus mode: a 16-bit register or FIFO word goes high byte, then low byte.
 *
 * What is modelled
 *   - the address register and the registers r02-rFF as bytes, r80-rFF stepping the address register (5.2); the
 *     raster count RCR (r80) from the clock; CCR's ABT (set by reset: the FIFOs are shut until the driver clears it;
 *     setting it aborts a command and empties the FIFOs) and GBM (the bits a pixel)
 *   - the status register: CER, ARD, CED, RFF, RFR, WFR, WFE (5.3). Every command finishes the moment its last word
 *     arrives, so the write FIFO is always empty and ready, and CED is 0 only between a command's words
 *   - the write FIFO as the command stream, the read FIFO (16 bytes) for RD, RPR and RPTN
 *   - the drawing parameter registers Pr00-Pr13 (5.10) and the pattern RAM (16 words)
 *   - commands (6): ORG, WPR, RPR, WPTN, RPTN; RD, WT, MOD, CLR, SCLR, CPY, SCPY with the eight scan directions;
 *     AMOVE, RMOVE, ALINE, RLINE, ARCT, RRCT, APLL, RPLL, APLG, RPLG, AFRCT, RFRCT, DOT, AGCPY, RGCPY - with the
 *     colour modes (the pattern RAM picks CL0 / CL1, or suppresses), the eight operation modes and the eight area
 *     modes, at 1, 2, 4, 8 or 16 bits a pixel
 *   - the frame buffer: the card's 128K words of RAM (repeated up to $7FFFF) and, with MA19 high ($80000 up), the
 *     font EPROM, its byte on both halves of the word (v3font.h, generated by tools/v3font.py); writes there are lost
 * What is not
 *   - CRCL, ELPS, the arcs, PAINT, PTN and the DMA transfers (DRD, DWT, DMOD): each sets CER, is counted and named on
 *     stderr, so a program that needs one fails loudly here
 *   - how long a command takes; character screens (method A); the cursors, zoom, the light pen, interrupts
 *   - the chip's own choice of dots on a slanted line (this is Bresenham's; a level or upright line is exact), and
 *     the way a filled area walks the pattern RAM from line to line (PPY steps up a line at a time here; a solid
 *     pattern does not depend on it)
 *
 * The geometry (the manual's command pages): X runs with the bit number, bit 0 of a word the left-hand dot; Y points
 * up, one line up being one memory width lower in memory; a screen's line n starts at its start address + n x MW.
 */
#ifndef ACRTCMODEL_H
#define ACRTCMODEL_H
#include "v3font.h"

#define AC_RAMW   (1u << 17)                 /* the card's RAM: 128K words */
#define AC_FONT   0x80000u                   /* MA19 high: the font EPROM */
#define AC_DOTCLK 25175000ull                /* the oscillator; 2CLK is a quarter of it */

static struct {
    uint8_t ar, reg[256];
    uint16_t pr[32], ptn[16];
    uint16_t cmd[24]; int ncmd, need;        /* the command being collected: its words so far, the parameters it takes */
    int poly, polyn, polyfirst, px0, py0;    /* a polyline / polygon in progress: points to come */
    int half; uint8_t hi;                    /* the FIFO's byte pairing */
    uint8_t rf[16]; unsigned rfh, rfn;       /* the read FIFO */
    int cer, ard;
    int cx, cy, dn, orgdot; uint32_t org;    /* the current pointer, and the origin ORG set */
    unsigned long done, missing; uint8_t told[32];
    int log;
} ac;
static uint16_t ac_ram[AC_RAMW];

static void ac_reset(void) {
    memset(&ac, 0, sizeof ac);
    ac.reg[0x02] = 0x80;                     /* CCR: ABT set by RES */
}

/* ---- the frame buffer ---- */
static uint16_t ac_rd(uint32_t a) {
    a &= 0xFFFFF;
    if (a & AC_FONT) { unsigned i = a & 0x7FFF; uint8_t b = i < V3FONT_USED ? v3font[i] : 0; return (uint16_t)(b << 8 | b); }
    return ac_ram[a & (AC_RAMW - 1)];
}
static void ac_wr(uint32_t a, uint16_t v) { a &= 0xFFFFF; if (!(a & AC_FONT)) ac_ram[a & (AC_RAMW - 1)] = v; }

static int ac_bpp(void) { static const int t[8] = { 1, 2, 4, 8, 16, 1, 1, 1 }; return t[ac.reg[0x02] & 7]; }
static long ac_mw(int dn) { int r = 0xC2 + 8 * dn; return (ac.reg[r] & 0x0F) << 8 | ac.reg[r + 1]; }   /* MWR0-3 */
static uint32_t ac_sar(int dn) { int r = 0xC4 + 8 * dn; return (uint32_t)(ac.reg[r + 1] & 0x0F) << 16 | ac.reg[r + 2] << 8 | ac.reg[r + 3]; }
static int ac_s16(uint16_t v) { return (int16_t)v; }
static int ac_sgn(int v) { return v < 0 ? -1 : 1; }

/* ---- the read FIFO ---- */
static void ac_push(uint16_t w) {
    if (ac.rfn <= 14) { ac.rf[(ac.rfh + ac.rfn) & 15] = (uint8_t)(w >> 8); ac.rf[(ac.rfh + ac.rfn + 1) & 15] = (uint8_t)w; ac.rfn += 2; }
}

/* ---- the read / write pointer, and the data transfer commands (6.5) ---- */
static uint32_t ac_rwp(void) { return (uint32_t)(ac.pr[0x0C] & 0xFF) << 12 | ac.pr[0x0D] >> 4; }
static void ac_set_rwp(uint32_t a) {
    a &= 0xFFFFF;
    ac.pr[0x0C] = (uint16_t)((ac.pr[0x0C] & 0xC000) | a >> 12); ac.pr[0x0D] = (uint16_t)(a << 4);
}
static uint16_t ac_modify(uint16_t old, uint16_t d, int mm, uint16_t mask) {
    uint16_t f = mm == 0 ? d : mm == 1 ? (old | d) : mm == 2 ? (old & d) : (old ^ d);
    return (uint16_t)((old & ~mask) | (f & mask));
}

/* CLR / SCLR: the area from RWP, AX words along the line (its sign the way), AY lines (positive = up) */
static void ac_clear(uint16_t d, int ax, int ay, int sel, int mm) {
    long mw = ac_mw(ac.pr[0x0C] >> 14); uint32_t p = ac_rwp(); uint16_t mask = ac.pr[0x04];
    for (int j = 0; j <= abs(ay); j++) {
        long line = (long)p - (long)ac_sgn(ay) * j * mw;
        for (int i = 0; i <= abs(ax); i++) {
            uint32_t a = (uint32_t)(line + ac_sgn(ax) * i);
            ac_wr(a, sel ? ac_modify(ac_rd(a), d, mm, mask) : d);
        }
    }
    ac_set_rwp((uint32_t)((long)p - (long)ac_sgn(ay) * (abs(ay) + 1) * mw));
}

/* the two steps of a scan: along it and from one pass to the next, for the destination direction DSD (tables C14-2,
   C37-2); `up` is one line up, `right` one word or dot to the right */
static void ac_dsd(int dsd, long right, long up, long *in, long *out) {
    switch (dsd & 7) {
        case 0: *in = right; *out = up; break;      case 1: *in = right; *out = -up; break;
        case 2: *in = -right; *out = up; break;     case 3: *in = -right; *out = -up; break;
        case 4: *in = up; *out = right; break;      case 5: *in = -up; *out = right; break;
        case 6: *in = up; *out = -right; break;     default: *in = -up; *out = -right; break;
    }
}

/* CPY / SCPY: the source area from Pss (AX words, AY lines, their signs the way), scanned along the lines (S = 0) or
   down the columns (S = 1), to the destination from RWP in the direction DSD */
static void ac_copy(int op, uint32_t src, int ax, int ay, int sel) {
    long mw = ac_mw(ac.pr[0x0C] >> 14); uint32_t dst = ac_rwp(); uint16_t mask = ac.pr[0x04];
    int s = op >> 11 & 1, nx = abs(ax) + 1, ny = abs(ay) + 1;
    long sx = ac_sgn(ax), sy = -(long)ac_sgn(ay) * mw;                 /* a positive AY is up: lower addresses */
    long sin = s ? sy : sx, sout = s ? sx : sy, din, dout;
    int nin = s ? ny : nx, nout = s ? nx : ny;
    ac_dsd(op >> 8, 1, -mw, &din, &dout);
    for (int j = 0; j < nout; j++)
        for (int i = 0; i < nin; i++) {
            uint16_t w = ac_rd((uint32_t)((long)src + j * sout + i * sin));
            uint32_t a = (uint32_t)((long)dst + j * dout + i * din);
            ac_wr(a, sel ? ac_modify(ac_rd(a), w, op & 3, mask) : w);
        }
    ac_set_rwp((uint32_t)((long)dst + nout * dout));
}

/* ---- dots (6.6, 6.8) ---- */
static void ac_locate(int x, int y, uint32_t *a, int *sh) {
    int bpp = ac_bpp(), ppw = 16 / bpp;
    long t = ac.orgdot / bpp + (long)x;
    long w = t >= 0 ? t / ppw : -((-t + ppw - 1) / ppw);
    *sh = (int)(t - w * ppw) * bpp;
    *a = (uint32_t)((long)ac.org - (long)y * ac_mw(ac.dn) + w) & 0xFFFFF;
}
static uint16_t ac_field(void) { int b = ac_bpp(); return (uint16_t)(b == 16 ? 0xFFFF : (1u << b) - 1); }

/* the area modes (6.6.3): 1 = draw, 0 = not this dot, -1 = stop the command */
static int ac_area(int x, int y, int area) {
    int in = x >= ac_s16(ac.pr[8]) && x <= ac_s16(ac.pr[10]) && y >= ac_s16(ac.pr[9]) && y <= ac_s16(ac.pr[11]);
    switch (area) {
        case 1: if (!in) { ac.ard = 1; return -1; } return 1;
        case 2: return in;
        case 3: if (!in) ac.ard = 1; return in;
        case 5: if (in) { ac.ard = 1; return -1; } return 1;
        case 6: return !in;
        case 7: if (in) ac.ard = 1; return !in;
        default: return 1;
    }
}

/* one dot of colour `col` (a whole word, the dot's field taken from it) under the operation mode */
static void ac_put(int x, int y, uint16_t col, int opm) {
    uint32_t a; int sh; ac_locate(x, y, &a, &sh);
    uint16_t m = (uint16_t)(ac_field() << sh), old = ac_rd(a), p = old & m, c = col & m, cmp = ac.pr[2] & m, n;
    switch (opm) {
        case 0: n = c; break;                case 1: n = p | c; break;
        case 2: n = p & c; break;            case 3: n = p ^ c; break;
        case 4: if (p != cmp) return; n = c; break;
        case 5: if (p == cmp) return; n = c; break;
        case 6: if (!(p < c)) return; n = c; break;
        default: if (!(p > c)) return; n = c; break;
    }
    ac_wr(a, (uint16_t)((old & ~m) | n));
}

/* a dot as a drawing command makes it: the pattern RAM's bit at (PPX, PPY) picks the colour (6.6.2). 0 = stop */
static int ac_plot(int x, int y, int op) {
    int ppx = ac.pr[5] >> 4 & 15, ppy = ac.pr[5] >> 12 & 15, col = op >> 3 & 3;
    int r = ac_area(x, y, op >> 5 & 7);
    if (r < 0) return 0;
    if (r) {
        int bit = ac.ptn[ppy] >> ppx & 1;
        if (col == 3) ac_put(x, y, ac.ptn[(ppy & 3) * 4 + (ppx & 3)], op & 7);
        else if (col == 0) ac_put(x, y, ac.pr[bit], op & 7);
        else if (col == 1) { if (bit) ac_put(x, y, ac.pr[1], op & 7); }
        else if (!bit) ac_put(x, y, ac.pr[0], op & 7);
    }
    return 1;
}
/* the pattern pointer's step along X (after every dot) and along Y (after every line of a filled area), with the
   pattern's zoom (PRC: Pr05 the pointers and zoom counts, Pr06 the start, Pr07 the end and the zoom) */
static void ac_pstep(int y) {
    int sh = y ? 12 : 4, zs = y ? 8 : 0;
    int pp = ac.pr[5] >> sh & 15, zc = ac.pr[5] >> zs & 15, ps = ac.pr[6] >> sh & 15, pe = ac.pr[7] >> sh & 15, pz = ac.pr[7] >> zs & 15;
    if (zc >= pz) { zc = 0; pp = pp == pe ? ps : (pp + 1) & 15; } else zc++;
    ac.pr[5] = (uint16_t)((ac.pr[5] & ~(15u << sh | 15u << zs)) | (unsigned)pp << sh | (unsigned)zc << zs);
}

/* a line from the current pointer to (x1, y1); the last dot is not drawn and becomes the current pointer */
static int ac_line(int x1, int y1, int op) {
    int x = ac.cx, y = ac.cy, dx = abs(x1 - x), dy = -abs(y1 - y), sx = x < x1 ? 1 : -1, sy = y < y1 ? 1 : -1, e = dx + dy;
    while (x != x1 || y != y1) {
        if (!ac_plot(x, y, op)) { ac.cx = x; ac.cy = y; return 0; }
        ac_pstep(0);
        int e2 = 2 * e;
        if (e2 >= dy) { e += dy; x += sx; }
        if (e2 <= dx) { e += dx; y += sy; }
    }
    ac.cx = x1; ac.cy = y1;
    return 1;
}

/* AFRCT / RFRCT: the rectangle between the current pointer and (x1, y1), both included, a line at a time from the
   current pointer's; the pointer ends one line past it (figure C32-3) */
static void ac_fill(int x1, int y1, int op) {
    int x0 = ac.cx, y0 = ac.cy, sx = x1 >= x0 ? 1 : -1, sy = y1 >= y0 ? 1 : -1;
    uint16_t px = ac.pr[5] & 0x00FF;
    for (int y = y0; ; y += sy) {
        ac.pr[5] = (uint16_t)((ac.pr[5] & 0xFF00) | px);
        for (int x = x0; ; x += sx) {
            if (!ac_plot(x, y, op)) { ac.cx = x; ac.cy = y; return; }
            ac_pstep(0);
            if (x == x1) break;
        }
        ac_pstep(1);
        if (y == y1) break;
    }
    ac.pr[5] = (uint16_t)((ac.pr[5] & 0xFF00) | px);
    ac.cx = x0; ac.cy = y1 + sy;
}

/* AGCPY / RGCPY: the dots of the source area, from (xs, ys) by (dx, dy), to the current pointer in the direction DSD */
static void ac_gcopy(int op, int xs, int ys, int dx, int dy) {
    int s = op >> 11 & 1, nx = abs(dx) + 1, ny = abs(dy) + 1, nin = s ? ny : nx, nout = s ? nx : ny;
    int x0 = ac.cx, y0 = ac.cy;
    long dinx = 0, diny = 0, doutx = 0, douty = 0, in, out;
    ac_dsd(op >> 8, 1, 1000, &in, &out);                                /* 1 = a dot right, 1000 = a line up */
    if (labs(in) == 1) { dinx = in; douty = out / 1000; } else { diny = in / 1000; doutx = out; }
    for (int j = 0; j < nout; j++)
        for (int i = 0; i < nin; i++) {
            int sx = xs + (s ? j : i) * ac_sgn(dx), sy = ys + (s ? i : j) * ac_sgn(dy);
            int x = x0 + (int)(i * dinx + j * doutx), y = y0 + (int)(i * diny + j * douty);
            uint32_t a; int sh, dsh; ac_locate(sx, sy, &a, &sh);
            uint16_t v = (uint16_t)(ac_rd(a) >> sh & ac_field());
            int r = ac_area(x, y, op >> 5 & 7);
            if (r < 0) { ac.cx = x; ac.cy = y; return; }
            if (r) { ac_locate(x, y, &a, &dsh); ac_put(x, y, (uint16_t)(v << dsh), op & 7); }
        }
    ac.cx = x0 + (int)(nout * doutx); ac.cy = y0 + (int)(nout * douty);
}

/* ---- the command stream ---- */
static const char *ac_name(int hb) {
    static const struct { int hb, mask; const char *n; } t[] = {
        { 0x24, 0xFF, "DRD" }, { 0x28, 0xFF, "DWT" }, { 0x2C, 0xFF, "DMOD" }, { 0xA8, 0xFE, "CRCL" }, { 0xAC, 0xFE, "ELPS" },
        { 0xB0, 0xFE, "AARC" }, { 0xB4, 0xFE, "RARC" }, { 0xB8, 0xFE, "AEARC" }, { 0xBC, 0xFE, "REARC" },
        { 0xC8, 0xFE, "PAINT" }, { 0xD0, 0xF0, "PTN" } };
    for (unsigned i = 0; i < sizeof t / sizeof *t; i++) if ((hb & t[i].mask) == t[i].hb) return t[i].n;
    return 0;
}
/* how many parameter words follow the op-code; -1 = the first parameter says (WPTN, the polylines) */
static int ac_params(uint16_t op) {
    int hb = op >> 8;
    if (hb == 0x04) return 2;                                           /* ORG */
    if (hb == 0x08) return 1;                                           /* WPR */
    if (hb == 0x0C || hb == 0x44 || hb == 0xCC) return 0;               /* RPR, RD, DOT */
    if (hb == 0x18) return -1;                                          /* WPTN */
    if (hb == 0x1C || hb == 0x48 || hb == 0x4C) return 1;               /* RPTN, WT, MOD */
    if (hb == 0x58 || hb == 0x5C) return 3;                             /* CLR, SCLR */
    if ((hb & 0xE0) == 0x60) return 4;                                  /* CPY, SCPY */
    if (hb == 0x80 || hb == 0x84 || hb == 0x88 || hb == 0x8C || hb == 0x90 || hb == 0x94 || hb == 0xC0 || hb == 0xC4) return 2;
    if (hb == 0x98 || hb == 0x9C || hb == 0xA0 || hb == 0xA4) return -1;   /* the polylines and polygons */
    if ((hb & 0xE0) == 0xE0) return 4;                                  /* AGCPY, RGCPY */
    if (hb == 0x24 || hb == 0x28 || hb == 0x2C) return 2;               /* the DMA transfers: not modelled */
    if ((hb & 0xFE) == 0xA8 || (hb & 0xF0) == 0xD0) return 1;           /* CRCL, PTN */
    if ((hb & 0xFE) == 0xAC) return 3;                                  /* ELPS */
    if ((hb & 0xFE) == 0xB0 || (hb & 0xFE) == 0xB4) return 4;           /* AARC, RARC */
    if ((hb & 0xFE) == 0xB8 || (hb & 0xFE) == 0xBC) return 6;           /* AEARC, REARC */
    if ((hb & 0xFE) == 0xC8) return 0;                                  /* PAINT */
    return -2;                                                          /* not a command */
}

static void ac_exec(void) {
    uint16_t op = ac.cmd[0], *p = ac.cmd + 1; int hb = op >> 8;
    const char *miss = ac_name(hb);
    ac.done++;
    if (ac.log) {
        fprintf(stderr, "video: ACRTC %04X", op);
        for (int i = 1; i < ac.ncmd; i++) fprintf(stderr, " %04X", ac.cmd[i]);
        fprintf(stderr, "\n");
    }
    if (miss) {
        ac.cer = 1; ac.missing++;
        if (!(ac.told[hb >> 3] >> (hb & 7) & 1)) {
            ac.told[hb >> 3] |= (uint8_t)(1 << (hb & 7));
            fprintf(stderr, "video: ACRTC command %04X (%s) is not modelled: CER set\n", op, miss);
        }
        return;
    }
    if (hb == 0x04) {                                                   /* ORG: the origin's screen, address and dot */
        ac.dn = p[0] >> 14; ac.org = (uint32_t)(p[0] & 0xFF) << 12 | p[1] >> 4; ac.orgdot = p[1] & 15; ac.cx = ac.cy = 0;
    } else if (hb == 0x08) { int rn = op & 0x1F; if (rn < 0x10) ac.pr[rn] = p[0]; }
    else if (hb == 0x0C) {
        int rn = op & 0x1F; uint16_t v = ac.pr[rn];
        if (rn == 0x10 || rn == 0x11) {                                 /* DP: where the current pointer is in memory */
            uint32_t a; int sh; ac_locate(ac.cx, ac.cy, &a, &sh);
            v = rn == 0x10 ? (uint16_t)(ac.dn << 14 | a >> 12) : (uint16_t)(a << 4 | sh);
        } else if (rn == 0x12) v = (uint16_t)ac.cx; else if (rn == 0x13) v = (uint16_t)ac.cy;
        ac_push(v); ac.ard = 0;
    } else if (hb == 0x18) { for (int i = 0; i < ac.need - 1; i++) ac.ptn[(op + i) & 15] = p[1 + i]; }
    else if (hb == 0x1C) { for (int i = 0; i < p[0] / 2; i++) ac_push(ac.ptn[(op + i) & 15]); }
    else if (hb == 0x44) { ac_push(ac_rd(ac_rwp())); ac_set_rwp(ac_rwp() + 1); }
    else if (hb == 0x48) { ac_wr(ac_rwp(), p[0]); ac_set_rwp(ac_rwp() + 1); }
    else if (hb == 0x4C) { uint32_t a = ac_rwp(); ac_wr(a, ac_modify(ac_rd(a), p[0], op & 3, ac.pr[4])); ac_set_rwp(a + 1); }
    else if (hb == 0x58) ac_clear(p[0], ac_s16(p[1]), ac_s16(p[2]), 0, 0);
    else if (hb == 0x5C) ac_clear(p[0], ac_s16(p[1]), ac_s16(p[2]), 1, op & 3);
    else if ((hb & 0xE0) == 0x60) ac_copy(op, (uint32_t)(p[0] & 0xFF) << 12 | p[1] >> 4, ac_s16(p[2]), ac_s16(p[3]), hb & 0x10);
    else if (hb == 0x80) { ac.cx = ac_s16(p[0]); ac.cy = ac_s16(p[1]); }
    else if (hb == 0x84) { ac.cx += ac_s16(p[0]); ac.cy += ac_s16(p[1]); }
    else if (hb == 0x88) ac_line(ac_s16(p[0]), ac_s16(p[1]), op);
    else if (hb == 0x8C) ac_line(ac.cx + ac_s16(p[0]), ac.cy + ac_s16(p[1]), op);
    else if (hb == 0x90 || hb == 0x94) {                                /* ARCT, RRCT: along X first, back to the start */
        int x0 = ac.cx, y0 = ac.cy, x1 = hb == 0x90 ? ac_s16(p[0]) : x0 + ac_s16(p[0]), y1 = hb == 0x90 ? ac_s16(p[1]) : y0 + ac_s16(p[1]);
        if (ac_line(x1, y0, op) && ac_line(x1, y1, op) && ac_line(x0, y1, op)) ac_line(x0, y0, op);
    } else if (hb == 0xC0) ac_fill(ac_s16(p[0]), ac_s16(p[1]), op);
    else if (hb == 0xC4) ac_fill(ac.cx + ac_s16(p[0]), ac.cy + ac_s16(p[1]), op);
    else if (hb == 0xCC) { if (ac_plot(ac.cx, ac.cy, op)) ac_pstep(0); }
    else if ((hb & 0xF0) == 0xE0) ac_gcopy(op, ac_s16(p[0]), ac_s16(p[1]), ac_s16(p[2]), ac_s16(p[3]));
    else if ((hb & 0xF0) == 0xF0) ac_gcopy(op, ac.cx + ac_s16(p[0]), ac.cy + ac_s16(p[1]), ac_s16(p[2]), ac_s16(p[3]));
}

/* one word from the write FIFO */
static void ac_word(uint16_t w) {
    if (ac.poly) {                                                      /* a polyline's or polygon's next coordinate */
        ac.cmd[1 + (ac.polyn & 1)] = w;
        if (ac.polyn++ & 1) {
            uint16_t op = ac.cmd[0]; int rel = op >> 8 & 4;
            int x = rel ? ac.cx + ac_s16(ac.cmd[1]) : ac_s16(ac.cmd[1]), y = rel ? ac.cy + ac_s16(ac.cmd[2]) : ac_s16(ac.cmd[2]);
            ac_line(x, y, op);
            if (--ac.poly == 0 && (op >> 8 & 0xF8) == 0xA0) ac_line(ac.px0, ac.py0, op);   /* a polygon closes */
            if (!ac.poly) ac.ncmd = 0;
        }
        return;
    }
    if (ac.ncmd == 0) {
        ac.need = ac_params(w);
        if (ac.need == -2) { ac.cer = 1; if (ac.log) fprintf(stderr, "video: ACRTC %04X is not a command: CER set\n", w); return; }
        ac.cmd[0] = w; ac.ncmd = 1;
    } else {
        if (ac.ncmd < (int)(sizeof ac.cmd / sizeof *ac.cmd)) ac.cmd[ac.ncmd] = w;
        ac.ncmd++;
        if (ac.need == -1) {                                            /* the count has arrived */
            int hb = ac.cmd[0] >> 8;
            if (hb == 0x18) ac.need = 1 + (w / 2 > 16 ? 16 : w / 2);     /* WPTN: the count is in bytes on the 8-bit bus */
            else {
                ac.done++; ac.poly = w; ac.polyn = 0; ac.px0 = ac.cx; ac.py0 = ac.cy;
                if (!w) ac.ncmd = 0;
                return;
            }
        }
    }
    if (ac.ncmd - 1 == ac.need) { ac_exec(); ac.ncmd = 0; }
}

/* ---- the host side: RS and R/W as the card's four ports give them ---- */
static unsigned ac_raster(unsigned long long clk, unsigned long long cpu_hz) {
    unsigned hc = ac.reg[0x82] + 1u, vc = (ac.reg[0x86] & 0x0Fu) << 8 | ac.reg[0x87];
    if (!(ac.reg[0x04] & 0x40) || !vc) return 0;                        /* OMR's STR: the chip is stopped */
    unsigned long long mc = clk * (AC_DOTCLK / 8) / cpu_hz;             /* memory cycles: 2CLK / 2 */
    return (unsigned)(mc / hc % vc);
}
static int ac_status(void) {
    return ac.cer << 7 | ac.ard << 6 | (ac.ncmd == 0 && !ac.poly && !ac.half) << 5 | (ac.rfn == 16) << 3 | (ac.rfn > 0) << 2 | 3;
}
static void ac_write_ar(uint8_t v) { ac.ar = v; }
static void ac_write_data(uint8_t v) {
    if (ac.ar < 2) {                                                    /* the write FIFO: high byte, low byte */
        if (ac.reg[0x02] & 0x80) return;                                /* ABT: the FIFOs are shut */
        if (!ac.half) { ac.hi = v; ac.half = 1; } else { ac.half = 0; ac_word((uint16_t)(ac.hi << 8 | v)); }
        return;
    }
    ac.reg[ac.ar] = v;
    if (ac.ar == 0x02 && (v & 0x80)) {                                  /* ABT: the command dropped, the FIFOs emptied */
        ac.ncmd = ac.poly = ac.half = 0; ac.rfn = 0; ac.cer = ac.ard = 0;
    }
    if (ac.ar >= 0x80) ac.ar++;
}
static int ac_read_data(unsigned long long clk, unsigned long long cpu_hz) {
    int v;
    if (ac.ar < 2) {                                                    /* the read FIFO; empty, the bus floats */
        if (!ac.rfn) return 0xFF;
        v = ac.rf[ac.rfh]; ac.rfh = (ac.rfh + 1) & 15; ac.rfn--;
        return v;
    }
    if (ac.ar == 0x80 || ac.ar == 0x81) { unsigned r = ac_raster(clk, cpu_hz); v = ac.ar == 0x80 ? (int)(r >> 8) : (int)(r & 0xFF); }
    else v = ac.reg[ac.ar];
    if (ac.ar >= 0x80) ac.ar++;
    return v;
}

#endif
